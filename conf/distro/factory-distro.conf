## conf/distro/factory-distro.conf
```bitbake
DISTRO_VERSION = "scarthgap"
DISTRO_NAME = "Akkodis Edge factory distro"
DISTRO_FEATURES_DEFAULT = "argp ext2 largefile usbhost xattr"

VIRTUAL-RUNTIME:init_manager = "busybox"
```

## conf/layer.conf
```bitbake
# We have a conf and classes directory, add to BBPATH
BBPATH .= ":${LAYERDIR}"

# We have a packages directory, add to BBFILES
BBFILES += "${LAYERDIR}/recipes-*/*/*.bb \
            ${LAYERDIR}/recipes-*/*/*.bbappend"

BBFILE_COLLECTIONS += "bsp-common-layer"
BBFILE_PATTERN_bsp-common-layer := "^${LAYERDIR}/"
BBFILE_PRIORITY_bsp-common-layer = "5"

LAYERDEPENDS_bsp-common-layer = "core"
LAYERSERIES_COMPAT_bsp-common-layer = "kirkstone"

# Let us add layer-specific bbappends which are only applied when that
# layer is included in our configuration
BBFILES += "${@' '.join('${LAYERDIR}/%s/recipes*/*/*.bbappend' % layer \
               for layer in BBFILE_COLLECTIONS.split())}"
```
